## build_pi/conf/bblayers.conf
```bitbake
# POKY_BBLAYERS_CONF_VERSION is increased each time build/conf/bblayers.conf
# changes incompatibly
POKY_BBLAYERS_CONF_VERSION = "2"

BBPATH = "${TOPDIR}"
BBFILES ?= ""

BBLAYERS ?= " \
  /home/user/yocto/poky/meta \
  /home/user/yocto/poky/meta-poky \
  /home/user/yocto/poky/meta-yocto-bsp \
  /home/user/yocto/meta-openembedded/meta-oe \
  /home/user/yocto/meta-openembedded/meta-python \
  /home/user/yocto/meta-openembedded/meta-multimedia \
  /home/user/yocto/meta-openembedded/meta-networking \
  /home/user/yocto/meta-raspberrypi \
  /home/user/yocto/meta-syruse \
  /home/user/yocto/meta-wayland \
  /home/user/yocto/meta-qt6 \
  "
```

## conf/layer.conf
```bitbake
# We have a conf and classes directory, add to BBPATH
BBPATH .= ":${LAYERDIR}"

# We have recipes-* directories, add to BBFILES
BBFILES += "${LAYERDIR}/recipes-*/*/*.bb \
            ${LAYERDIR}/recipes-*/*/*.bbappend"

BBFILE_COLLECTIONS += "meta-syruse"
BBFILE_PATTERN_meta-syruse = "^${LAYERDIR}/"
BBFILE_PRIORITY_meta-syruse = "10"

LAYERDEPENDS_meta-syruse = "core"
LAYERSERIES_COMPAT_meta-syruse = "walnascar"

#PLACE THESE INTO local.conf
INIT_MANAGER = "systemd"

IMAGE_INSTALL:append = " wlroots "
PREFERRED_VERSION_wlroots = "0.19-dev"

IMAGE_INSTALL:append = " my-launcher "
IMAGE_INSTALL:append = " wl-compositor "
IMAGE_INSTALL:append = " qt6-main-app "
```
